// Annotated Thumb/ARM disassembler for the DCT3 flash.
//
// Uses the vendored mGBA decoder (same one the emulator runs). Flash is
// big-endian; instructions are read as big-endian halfwords (Thumb) / words
// (ARM). A real DCT3Core is created so PC-relative literal loads resolve.
//
// Annotations:
//   - `bl 0x002D724C`  -> appended `; BROKER_FAULT_NOTIFIER` when the target
//                          is a known address in the symbol sidecar
//   - `=0x0011FF94`    -> appended `; reboot_reason` when the literal value
//                          matches a known address (typically a RAM byte)
//   - `mov rN, #imm`   -> peephole-annotated `; MSG_KEY_DOWN` when the next
//                          BL hits a known task-send (or REBOOT_FN for reasons)
//
// Symbol sidecar is auto-located by fw-id (FNV-1a of the flash); use --symbols
// to override. Sidecar generated by tools/symbols/gen_symbols_txt.py.
//
// Usage: disfw <flash.fls> <addr> [count] [arm] [--symbols PATH] [--no-annot]
//
//   build: see Makefile target `disfw`
//
#include <ctype.h>
#include <dirent.h>
#include <stdint.h>
#include <stdio.h>
#include <stdlib.h>
#include <string.h>

#include "core/dct3_core.h"
#include "mgba/internal/arm/decoder.h"

#define BASE 0x00200000u

// Forward decls — xref_scan needs sym_lookup before its definition.
typedef struct { uint32_t key; char *name; } Sym;
static const char *sym_lookup(Sym *arr, int n, uint32_t key);
static Sym *g_addrs;
static int g_addrs_n;

// ---------- xref scanner ----------
// One-pass scan over the loaded flash builds two reverse maps:
//   * BL callers:   for every Thumb BL imm-encoded instruction, record
//                   (target -> caller_pc).
//   * Table refs:   for every 4-byte aligned word whose value (Thumb LSB
//                   stripped) lands in a known code-region address, record
//                   (value -> word_pc) — these are entries in dispatch /
//                   function-pointer tables.
// Sorted by target for binary-search lookup. Cost: ~10-20 ms for 2 MB flash.

enum { XREF_BL = 1, XREF_TABLE = 2, XREF_ARM_BL = 3 };

typedef struct { uint32_t target; uint32_t ref; uint8_t kind; } Xref;
static Xref *g_xref = NULL;
static int   g_xref_n = 0;
static int   g_xref_cap = 0;

// The loaded flash image (set in main) — for jump-table peek: read pointer-table
// entries out of a flash-resident table base.
static const uint8_t *g_flash = NULL;
static size_t         g_flash_n = 0;

// Optional RAM snapshot (disfw --ram, from boot_trace RAMDUMP): the full 16 MB image
// indexed by masked address. When present, memory reads resolve RAM-resident tables +
// live values, not just flash. NULL = flash-only.
static const uint8_t *g_ram = NULL;
static size_t         g_ram_n = 0;
#define RAM_MASK 0x00FFFFFFu

static void xref_push(uint32_t target, uint32_t ref, uint8_t kind) {
    if (g_xref_n == g_xref_cap) {
        g_xref_cap = g_xref_cap ? g_xref_cap * 2 : 4096;
        g_xref = realloc(g_xref, (size_t)g_xref_cap * sizeof *g_xref);
    }
    g_xref[g_xref_n].target = target;
    g_xref[g_xref_n].ref    = ref;
    g_xref[g_xref_n].kind   = kind;
    g_xref_n++;
}

static int xref_cmp(const void *a, const void *b) {
    const Xref *x = a, *y = b;
    if (x->target != y->target) return x->target < y->target ? -1 : 1;
    if (x->ref    != y->ref)    return x->ref    < y->ref    ? -1 : 1;
    return 0;
}

// Decode an ARM-mode B/BL/BLX-imm (32-bit insn) -> signed pc-rel offset, or
// LONG_MIN if not a recognised branch. Caller adds (pc + 8) to get the target.
//   bits[27:25] = 0b101  (B/BL)
//   bit[24]      = L      (1=BL, 0=B)
//   bits[23:0]   = signed imm24 (word offset)
// BLX-imm encoding (cond=0xF, bits[27:25]=0b101) — handle by sharing the same
// imm24 path; the resulting target gets Thumb-bit set by hardware but for
// callgraph purposes we mask it off (target = address-aligned entry).
#include <limits.h>
static long arm_branch_offset(uint32_t insn) {
    // condition + opcode discriminator
    uint32_t cond = (insn >> 28) & 0xF;
    uint32_t op   = (insn >> 25) & 0x7;
    if (op != 0x5) return LONG_MIN;                  // not B/BL/BLX-imm
    if (cond == 0xF) {
        // BLX (immediate). H bit is bit[24] (the L bit's slot here).
        // Target offset is imm24<<2 + (H<<1). For our caller-graph use, we
        // only need the aligned target, so the +H half-bit is irrelevant.
    }
    int32_t imm = (int32_t)(insn & 0xFFFFFF);
    if (imm & 0x800000) imm -= 0x1000000;             // sign-extend imm24
    return (long)imm << 2;
}

// Decode a Thumb BL T1 pair (hi, lo) -> signed pc-rel offset, or LONG_MIN if
// not a BL. Caller adds (pc + 4) to get the target. Same decoder math as our
// Python scanners (tools/sigfind.py walkers).
// IMPORTANT: backward branches return negative offsets — caller must check
// against LONG_MIN, NOT `off < 0`. Earlier bug skipped 2 of REBOOT_FN's 7
// Thumb callers because they had negative pc-rel offsets.
static long thumb_bl_offset(uint16_t hi, uint16_t lo) {
    if ((hi >> 11) != 0x1Eu) return LONG_MIN;   // F0 prefix
    if ((lo >> 14) != 0x3u)  return LONG_MIN;   // F8/FF suffix
    uint32_t S = (hi >> 10) & 1u;
    uint32_t imm10 = hi & 0x3FFu;
    uint32_t J1 = (lo >> 13) & 1u, J2 = (lo >> 11) & 1u;
    uint32_t imm11 = lo & 0x7FFu;
    uint32_t I1 = 1u ^ (J1 ^ S), I2 = 1u ^ (J2 ^ S);
    int32_t imm = (int32_t)((S << 24) | (I1 << 23) | (I2 << 22) | (imm10 << 12) | (imm11 << 1));
    if (S) imm -= (1 << 25);
    return imm;
}

// Build the BL-caller + table-entry reverse maps after both the flash and
// symbol sidecar have loaded. Run once.
static void xref_scan(const uint8_t *flash, size_t flash_n) {
    // Thumb BL caller pass — every halfword boundary tries the 32-bit Thumb
    // BL decode. The pre-half/post-half match is permissive (no surrounding
    // context check), so this *will* sometimes catch the second half of an
    // overlapping pair OR a pair lying inside a data table that happens to
    // look like a BL. Targets that don't sit in flash get filtered; we also
    // filter targets that don't look like fn entries when emitting the
    // prologue banner, so a stray match here is harmless noise in the
    // count but won't produce a misleading "called by N" report on any
    // un-targeted fn.
    for (size_t o = 0; o + 3 < flash_n; o += 2) {
        uint16_t hi = (uint16_t)((flash[o]     << 8) | flash[o + 1]);
        uint16_t lo = (uint16_t)((flash[o + 2] << 8) | flash[o + 3]);
        long off = thumb_bl_offset(hi, lo);
        if (off == LONG_MIN) continue;
        uint32_t caller = (uint32_t)(BASE + o);
        uint32_t target = (uint32_t)((int32_t)(caller + 4) + off) & ~1u;
        if (target < BASE || target >= BASE + flash_n) continue;
        xref_push(target, caller, XREF_BL);
    }
    // ARM BL caller pass — every 4-byte aligned boundary tries the 32-bit
    // ARM B/BL/BLX-imm decode. DCT3 firmware is mostly Thumb, so ARM BL is
    // rare (a few dozen ref sites total) — but it's the only way to find
    // calls from the ARM-mode regions (e.g. the scheduler core at
    // 0x2E520C, the IRQ/FIQ trampolines). Without this we'd miss callers
    // like FATAL_HANDLER's ARM-mode call into REBOOT_FN.
    //
    // False-positive rate is higher than Thumb scan (Thumb code at a 4-aligned
    // boundary can land on bits[27:25]=0b101 by coincidence). To filter,
    // we ONLY accept BL where the target is a known symbol — the unlabelled
    // call sites are too noisy to be useful, and a function we've named
    // really shouldn't have spurious BL-target matches.
    for (size_t o = 0; o + 4 <= flash_n; o += 4) {
        uint32_t insn = ((uint32_t)flash[o]     << 24)
                      | ((uint32_t)flash[o + 1] << 16)
                      | ((uint32_t)flash[o + 2] <<  8)
                      |  (uint32_t)flash[o + 3];
        long off = arm_branch_offset(insn);
        if (off == LONG_MIN) continue;
        // We want BL only (bit[24]=1), or BLX-imm (cond=0xF). Skip plain B
        // — it's a branch within the same fn, not a call.
        uint32_t cond = (insn >> 28) & 0xFu;
        int is_bl  = ((insn >> 24) & 1u) && cond != 0xFu;
        int is_blx = (cond == 0xFu);
        if (!is_bl && !is_blx) continue;
        uint32_t caller = (uint32_t)(BASE + o);
        uint32_t target = (uint32_t)((int32_t)(caller + 8) + off) & ~1u;
        if (target < BASE || target >= BASE + flash_n) continue;
        // Filter: only record refs whose target is a known symbol. Cuts
        // 99% of the false positives from non-ARM regions being misread.
        if (!sym_lookup(g_addrs, g_addrs_n, target)) continue;
        xref_push(target, caller, XREF_ARM_BL);
    }
    // Table-entry pass — every 4-byte aligned word: if value (stripped of
    // Thumb LSB) hits a known symbol address, treat the word's location as a
    // table reference. We only consider values within the flash code region
    // — RAM/MMIO targets would never sit in a function-pointer table.
    for (size_t o = 0; o + 4 <= flash_n; o += 2) {
        uint32_t w = ((uint32_t)flash[o]     << 24)
                   | ((uint32_t)flash[o + 1] << 16)
                   | ((uint32_t)flash[o + 2] <<  8)
                   |  (uint32_t)flash[o + 3];
        uint32_t v = w & ~1u;
        if (v < BASE || v >= BASE + flash_n) continue;
        // A heuristic: real fn pointers point at Thumb code (LSB = 1) OR
        // are 4-byte aligned ARM jumps. Skip values without the Thumb bit
        // unless 4-aligned (cuts the false-positive count by ~90%).
        if (!(w & 1u) && (v & 3u)) continue;
        // Plausibility filter: the value must look like the START of an
        // executable insn — Thumb prologue or known symbol entry. Cheap
        // check: matches known symbol OR points at a 0xBxxx push instruction.
        const char *name = sym_lookup(g_addrs, g_addrs_n, v);
        int looks_thumb_push = 0;
        if (v >= BASE && v + 1 < BASE + flash_n) {
            uint8_t hi = flash[v - BASE];
            looks_thumb_push = (hi == 0xB5u || hi == 0xB4u);
        }
        if (!name && !looks_thumb_push) continue;
        xref_push(v, (uint32_t)(BASE + o), XREF_TABLE);
    }
    qsort(g_xref, (size_t)g_xref_n, sizeof *g_xref, xref_cmp);
}

// Find the first xref entry with target == addr (binary search), return its
// index, or -1.
static int xref_first(uint32_t addr) {
    int lo = 0, hi = g_xref_n - 1, best = -1;
    while (lo <= hi) {
        int mid = (lo + hi) >> 1;
        if      (g_xref[mid].target < addr) lo = mid + 1;
        else if (g_xref[mid].target > addr) hi = mid - 1;
        else { best = mid; hi = mid - 1; }      // first match — keep going left
    }
    return best;
}

// Count refs of each kind at target. Optionally also writes the first N refs
// into the provided arrays. Returns total count.
static void xref_summary(uint32_t addr, int *out_bl, int *out_arm_bl, int *out_table,
                          uint32_t *first_bl, int *first_bl_n, int first_bl_cap,
                          uint32_t *first_arm_bl, int *first_arm_bl_n, int first_arm_bl_cap,
                          uint32_t *first_tab, int *first_tab_n, int first_tab_cap) {
    *out_bl = 0; *out_arm_bl = 0; *out_table = 0;
    if (first_bl_n)     *first_bl_n     = 0;
    if (first_arm_bl_n) *first_arm_bl_n = 0;
    if (first_tab_n)    *first_tab_n    = 0;
    int i = xref_first(addr);
    if (i < 0) return;
    for (; i < g_xref_n && g_xref[i].target == addr; i++) {
        switch (g_xref[i].kind) {
            case XREF_BL:
                if (first_bl_n && *first_bl_n < first_bl_cap)
                    first_bl[(*first_bl_n)++] = g_xref[i].ref;
                (*out_bl)++;
                break;
            case XREF_ARM_BL:
                if (first_arm_bl_n && *first_arm_bl_n < first_arm_bl_cap)
                    first_arm_bl[(*first_arm_bl_n)++] = g_xref[i].ref;
                (*out_arm_bl)++;
                break;
            case XREF_TABLE:
                if (first_tab_n && *first_tab_n < first_tab_cap)
                    first_tab[(*first_tab_n)++] = g_xref[i].ref;
                (*out_table)++;
                break;
        }
    }
}

// ---------- symbol store ----------
// (Sym typedef + g_addrs declared at top of file for xref_scan's forward use.)

static Sym *g_msgs  = NULL;     static int g_msgs_n  = 0;
static Sym *g_rsns  = NULL;     static int g_rsns_n  = 0;

static int sym_cmp(const void *a, const void *b) {
    uint32_t ka = ((const Sym *)a)->key, kb = ((const Sym *)b)->key;
    return (ka < kb) ? -1 : (ka > kb) ? 1 : 0;
}

// Exact-key lookup via binary search. Returns name or NULL.
static const char *sym_lookup(Sym *arr, int n, uint32_t key) {
    int lo = 0, hi = n - 1;
    while (lo <= hi) {
        int mid = (lo + hi) >> 1;
        if      (arr[mid].key < key) lo = mid + 1;
        else if (arr[mid].key > key) hi = mid - 1;
        else return arr[mid].name;
    }
    return NULL;
}

// Nearest-match (largest key <= target). Returns idx or -1. Caller computes
// the offset (target - arr[idx].key) — useful for "near SYM + 0xN" labels.
static int sym_nearest(Sym *arr, int n, uint32_t key) {
    int lo = 0, hi = n - 1, best = -1;
    while (lo <= hi) {
        int mid = (lo + hi) >> 1;
        if (arr[mid].key <= key) { best = mid; lo = mid + 1; }
        else hi = mid - 1;
    }
    return best;
}

// Compute the FNV-1a-32 hash of a byte range.
static uint32_t fnv1a32(const uint8_t *b, size_t n) {
    uint32_t h = 0x811C9DC5u;
    for (size_t i = 0; i < n; i++) { h ^= b[i]; h *= 0x01000193u; }
    return h ? h : 1;
}

// A 32-byte MCU version header looks like "V VV.VV\nDD-MM-YY\n<TYPE>\n(c) NMP.".
static int is_ver_hdr(const uint8_t *h) {
    return h[0] == 'V' && h[1] == ' ' && h[7] == '\n' && h[10] == '-' && h[13] == '-' && h[16] == '\n';
}
// Build-stable firmware id: hash the canonical 32-byte MCU version header, NOT the whole
// file — the EEPROM/FFS partition at the tail mutates per session and would give the same
// code-identical firmware different ids (e.g. `flash/My...fls` vs `firmware/Factory
// Reset...fls`). MAD2 puts the header at flash 0x1FC. The V1/serial-bus family (5110/6110/8810/…)
// has no 0x1FC header — its version header lives in the PPM/content block, always at a
// 64 KB-block boundary +4 (0xN0004) — so scan boundaries before the whole-file last resort.
static uint32_t fw_build_id(const uint8_t *d, size_t n) {
    const size_t HDR_LEN = 32;
    if (n >= 0x1FC + HDR_LEN && is_ver_hdr(d + 0x1FC))
        return fnv1a32(d + 0x1FC, HDR_LEN);            // MAD2 canonical
    for (size_t off = 0x4; off + HDR_LEN <= n; off += 0x10000)
        if (is_ver_hdr(d + off)) return fnv1a32(d + off, HDR_LEN);   // V1/serial-bus block header
    return fnv1a32(d, n);                              // last resort (non-DCT3)
}

// Append a symbol to one of the three arrays. Reallocs in chunks of 64.
static void sym_push(Sym **arr, int *n, int *cap, uint32_t key, const char *name) {
    if (*n == *cap) {
        *cap = *cap ? *cap * 2 : 64;
        *arr = realloc(*arr, (size_t)*cap * sizeof **arr);
    }
    (*arr)[*n].key = key;
    (*arr)[*n].name = strdup(name);
    (*n)++;
}

// Load the sidecar text file. Returns 1 on success, 0 on miss (no sidecar
// for this firmware — disfw just runs un-annotated).
static int load_symbols(const char *path) {
    FILE *f = fopen(path, "r");
    if (!f) return 0;
    char line[256];
    enum { SEC_NONE, SEC_A, SEC_M, SEC_R } sec = SEC_NONE;
    int a_cap = 0, m_cap = 0, r_cap = 0;
    while (fgets(line, sizeof line, f)) {
        // Strip trailing newline + comments.
        char *hash = strchr(line, '#');
        if (hash) *hash = 0;
        char *p = line;
        while (*p && isspace((unsigned char)*p)) p++;
        if (!*p) continue;
        if (*p == '[') {
            if      (!strncmp(p, "[addresses]", 11)) sec = SEC_A;
            else if (!strncmp(p, "[messages]",  10)) sec = SEC_M;
            else if (!strncmp(p, "[reasons]",    9)) sec = SEC_R;
            else                                     sec = SEC_NONE;
            continue;
        }
        if (sec == SEC_NONE) continue;
        // Parse `0xHEX NAME`
        uint32_t v;
        char name[128];
        if (sscanf(p, "%x %127s", &v, name) != 2) continue;
        switch (sec) {
            case SEC_A: sym_push(&g_addrs, &g_addrs_n, &a_cap, v, name); break;
            case SEC_M: sym_push(&g_msgs,  &g_msgs_n,  &m_cap, v, name); break;
            case SEC_R: sym_push(&g_rsns,  &g_rsns_n,  &r_cap, v, name); break;
            default: break;
        }
    }
    fclose(f);
    qsort(g_addrs, (size_t)g_addrs_n, sizeof *g_addrs, sym_cmp);
    qsort(g_msgs,  (size_t)g_msgs_n,  sizeof *g_msgs,  sym_cmp);
    qsort(g_rsns,  (size_t)g_rsns_n,  sizeof *g_rsns,  sym_cmp);
    return 1;
}

// ---------- peephole state ----------
// Track register-immediate writes (mov rN, #imm) over a short window so we
// can annotate the immediate when a subsequent BL/B targets a known
// SEND-style helper. This is the message-id detection — non-deterministic
// in general, but reliable when an exact send helper sits 1-4 insns after
// the mov.

typedef struct {
    int has_imm;        // 1 if this slot tracks a known imm
    int reg;            // 0..12
    uint32_t imm;       // the immediate value
    uint32_t insn_pc;   // where the mov was (so annotation can point back)
} ImmTrack;

#define WINDOW 8

static ImmTrack g_recent[12 + 1];  // last imm seen per register (r0..r12)

// Load-source provenance: which memory address a register was last LOADED from (set by
// mem_annot on a tracked load). Lets a following `cmp rX,#K` be annotated as a gate on
// that address — the [0x13B528]==0 / readiness-flag pattern. Survives the load's own
// has_imm clobber (the reg holds the loaded value); cleared on any non-load write.
typedef struct { int valid; uint32_t addr; } LoadSrc;
static LoadSrc g_loadsrc[12 + 1];
static void loadsrc_set(int reg, uint32_t addr) {
    if (reg >= 0 && reg <= 12) { g_loadsrc[reg].valid = 1; g_loadsrc[reg].addr = addr; }
}
static void loadsrc_clear(int reg) {
    if (reg >= 0 && reg <= 12) g_loadsrc[reg].valid = 0;
}

static void reg_mov_seen(int reg, uint32_t imm, uint32_t pc) {
    if (reg < 0 || reg > 12) return;
    g_recent[reg].has_imm = 1;
    g_recent[reg].reg = reg;
    g_recent[reg].imm = imm;
    g_recent[reg].insn_pc = pc;
    loadsrc_clear(reg);                 // now a known constant, not a loaded value
}
static void reg_clobber(int reg) {
    if (reg < 0 || reg > 12) return;
    g_recent[reg].has_imm = 0;
}
static void reg_reset_all(void) {
    for (int i = 0; i <= 12; i++) { g_recent[i].has_imm = 0; g_loadsrc[i].valid = 0; }
}

// ---------- annotation hooks ----------
// Known "send a msg" helper targets. When BL hits one of these, the
// peephole reads r0/r1 as task/msg id.
typedef enum {
    HOOK_NONE,
    HOOK_TASK_SEND,           // r0 = task id, r1 = msg id (NokiX SEND_TASK_MESSAGE)
    HOOK_TASK_SEND_IRQ,       // r0 = task id, r1 = msg id (IRQ-ctx variant)
    HOOK_REBOOT_FN,           // r0 = reason byte (REBOOT_FN entry)
    HOOK_REASON_SETTER,       // r0 = reason byte ([0x11FF94] := r0)
    HOOK_ASSERT_LOG,          // r0 = assert code, r1 = data half-word
} HookKind;

static HookKind classify_target(uint32_t target) {
    const char *name = sym_lookup(g_addrs, g_addrs_n, target);
    if (!name) return HOOK_NONE;
    if (!strcmp(name, "TASK_SEND") || !strcmp(name, "SEND_TASK_MESSAGE")) return HOOK_TASK_SEND;
    if (!strcmp(name, "TASK_SEND_IRQ"))                                   return HOOK_TASK_SEND_IRQ;
    if (!strcmp(name, "REBOOT_FN"))                                       return HOOK_REBOOT_FN;
    if (!strcmp(name, "REASON_SETTER"))                                   return HOOK_REASON_SETTER;
    if (!strcmp(name, "ASSERT_LOG"))                                      return HOOK_ASSERT_LOG;
    return HOOK_NONE;
}

// ---------- output ----------
// Each disasm line we print is buffered so we can right-pad before appending
// the annotation. ~80 cols seems to balance readable + annot-fits-on-line.
#define COL 56

static void emit(const char *line, const char *annot) {
    if (annot && *annot) {
        int len = (int)strlen(line);
        int pad = COL - len;
        if (pad < 1) pad = 1;
        printf("%s%*s; %s\n", line, pad, "", annot);
    } else {
        printf("%s\n", line);
    }
}

// ---------- per-line annotation ----------
// Looks at the decoded text + raw bytes; builds an annotation string.

static void annot_for_line(char *line, char *annot, size_t annot_n, uint32_t pc, int is_arm) {
    annot[0] = 0;

    // Find `bl 0x...` / `b<cond> 0x...` / `=0x...` markers and look up.
    // Multiple markers possible; concat with commas.
    char *p = line;
    int written = 0;
    // What's the "function" the current line sits in? We use this to suppress
    // intra-function branch annotations (a `beq 0x002EEBC0` from inside
    // REBOOT_FN is "near REBOOT_FN+0x12" — true but noisy).
    int self_idx = sym_nearest(g_addrs, g_addrs_n, pc);
    while ((p = strchr(p, '0')) != NULL) {
        if (p > line && p[-1] == '#') { p++; continue; }   // immediate #0xNN handled in peephole
        if (p[1] != 'x' && p[1] != 'X') { p++; continue; }
        uint32_t v = (uint32_t)strtoul(p, NULL, 16);
        p += 2;
        while (isxdigit((unsigned char)*p)) p++;

        // Walk back to find the operand context: `bl ` / `b<cond> ` / `=` /
        // `[pc, …]`. We treat `=` (LDR-PC literals) and `bl` differently from
        // conditional branches, because intra-fn branches don't deserve a
        // "near SYMBOL+0xN" label.
        char ctx[16] = "";
        char *q = p;
        while (q > line && (isxdigit((unsigned char)*(q - 1)) || *(q - 1) == 'x'
                            || *(q - 1) == '0')) q--;
        // q now points at the char immediately before "0x..." — skip a leading space if any
        while (q > line && q[-1] == ' ') q--;
        // Read up to 8 chars of operand-context backward.
        char *cs = q;
        while (cs > line && cs - q > -10) {
            cs--;
            if (*cs == '\n' || *cs == 0) { cs++; break; }
        }
        // Pluck the last alpha-only token before q.
        int ci = 0;
        for (char *r = q - 1; r >= cs && ci < 15; r--) {
            if (*r == ' ') {
                if (ci > 0) break;
                continue;
            }
            // We accept `=` as context (LDR literal-pool) and letters.
            if (*r == '=') { ctx[ci++] = '='; break; }
            if (isalpha((unsigned char)*r)) {
                memmove(ctx + 1, ctx, (size_t)ci);
                ctx[0] = (char)tolower((unsigned char)*r);
                ci++;
            } else if (ci > 0) {
                break;
            }
        }
        ctx[ci] = 0;
        int is_branch_cond = (ci > 0 && ctx[0] == 'b' && strcmp(ctx, "bl") != 0
                                                       && strcmp(ctx, "blx") != 0);
        int is_call        = (!strcmp(ctx, "bl") || !strcmp(ctx, "blx"));
        int is_ldr_lit     = (ctx[0] == '=');

        const char *name = sym_lookup(g_addrs, g_addrs_n, v);
        if (name) {
            int n = snprintf(annot + written, annot_n - written,
                             "%s%s", written ? ", " : "", name);
            if (n > 0) written += n;
            continue;
        }
        // Nearest-symbol annotation. Useful for jump-table targets + literal
        // loads. Suppress for conditional branches inside the same fn (noise).
        int idx = sym_nearest(g_addrs, g_addrs_n, v);
        if (idx < 0) continue;
        int off = (int)(v - g_addrs[idx].key);
        if (off <= 0 || off >= 0x1000) continue;
        if (is_branch_cond && idx == self_idx) continue;       // intra-fn branch — noise
        if (is_call) continue;                                 // BL/BLX should hit fn entry exactly; near-match is usually misleading
        if (!is_ldr_lit && !is_branch_cond) continue;          // only LDR literals + far branches get nearest-match
        int n = snprintf(annot + written, annot_n - written,
                         "%s%s+0x%X", written ? ", " : "", g_addrs[idx].name, off);
        if (n > 0) written += n;
    }

    (void)is_arm;
}

// Tracks/clobbers regs based on the disassembled string. Crude string-match,
// but adequate — we only care about the common immediate-mov forms that
// precede a SEND-style call.
//
//   "mov r0, #5"        -> reg 0 := 5
//   "mov r1, #0x366"    -> reg 1 := 0x366
//   "mov r2, sp"        -> clobber r2 (non-imm)
//   "ldr r1, =0x..."    -> reg 1 := (literal value, possibly an address)
//   "add r0, #1"        -> clobber r0
static void update_peephole(const char *line, uint32_t pc) {
    // Find first space after the mnemonic.
    const char *p = line;
    while (*p && !isspace((unsigned char)*p)) p++;
    while (*p && isspace((unsigned char)*p)) p++;
    if (!*p) return;

    // Inspect the leading mnemonic for known clobber-vs-set patterns.
    char mn[16] = {0};
    int mi = 0;
    // mGBA's disasm-only text is preceded in our line by "%08X: %04X       " — find
    // the mnemonic that follows the last "  " gap.
    const char *t = strstr(line, "  ");
    while (t && t[2] == ' ') t++;
    if (t) {
        t += 2;
        while (*t == ' ') t++;
        while (*t && isalpha((unsigned char)*t) && mi < 15) mn[mi++] = (char)tolower((unsigned char)*t++);
        while (*t == ' ') t++;
    } else {
        return;
    }
    mn[mi] = 0;

    // r0..r12 = first reg operand
    int rd = -1;
    if (*t == 'r') {
        t++;
        rd = 0;
        while (isdigit((unsigned char)*t)) { rd = rd * 10 + (*t - '0'); t++; }
        if (rd > 12) rd = -1;
    }
    // skip ", "
    while (*t == ',' || *t == ' ') t++;

    if (!strcmp(mn, "mov")) {
        if (rd < 0) return;
        if (*t == '#') {
            uint32_t imm = (uint32_t)strtoul(t + 1, NULL, 0);
            reg_mov_seen(rd, imm, pc);
        } else if (*t == 'r') {                 // mov rd, rn — copy tracked value
            int rn = (int)strtoul(t + 1, NULL, 10);
            if (rn >= 0 && rn <= 12 && g_recent[rn].has_imm)
                reg_mov_seen(rd, g_recent[rn].imm, pc);
            else
                reg_clobber(rd);
        } else {
            reg_clobber(rd);                    // mov rd, sp/pc
        }
    } else if (!strcmp(mn, "ldr")) {
        if (rd < 0) return;
        if (*t == '=') {
            uint32_t lit = (uint32_t)strtoul(t + 1, NULL, 0);
            reg_mov_seen(rd, lit, pc);
        } else {
            reg_clobber(rd);
        }
    } else if (!strcmp(mn, "add") || !strcmp(mn, "sub")) {
        // Propagate pointer arithmetic so `ldr rX,=BASE; add rX,#off` keeps a known
        // value (the common struct-field address build). Forms: `rd, #imm`,
        // `rd, rn, #imm`, `rd, pc, #imm` (ADR). Anything else clobbers rd.
        if (rd < 0) return;
        int sign = (mn[0] == 's') ? -1 : 1;
        if (*t == '#') {                         // add rd, #imm  (rd += imm)
            uint32_t imm = (uint32_t)strtoul(t + 1, NULL, 0);
            if (g_recent[rd].has_imm) g_recent[rd].imm += (uint32_t)(sign * (int)imm);
            else reg_clobber(rd);
            loadsrc_clear(rd);
        } else if (t[0] == 'p' && t[1] == 'c') {  // add rd, pc, #imm  (ADR)
            while (*t && *t != '#' && *t != '\n') t++;
            uint32_t imm = (*t == '#') ? (uint32_t)strtoul(t + 1, NULL, 0) : 0;
            reg_mov_seen(rd, (((pc + 4) & ~3u) + imm), pc);   // Align(PC,4)+imm
        } else if (*t == 'r') {                  // add rd, rn, #imm
            int rn = (int)strtoul(t + 1, NULL, 10);
            while (*t && *t != ',') t++;
            while (*t == ',' || *t == ' ') t++;
            if (*t == '#' && rn >= 0 && rn <= 12 && g_recent[rn].has_imm) {
                uint32_t imm = (uint32_t)strtoul(t + 1, NULL, 0);
                reg_mov_seen(rd, g_recent[rn].imm + (uint32_t)(sign * (int)imm), pc);
            } else {
                reg_clobber(rd);
                loadsrc_clear(rd);
            }
        } else {
            reg_clobber(rd);
            loadsrc_clear(rd);
        }
    } else if (!strcmp(mn, "ldrh") || !strcmp(mn, "ldrb") ||
               !strcmp(mn, "ldrsh") || !strcmp(mn, "ldrsb")) {
        // Loads clobber the known constant but KEEP load-source provenance (set by
        // mem_annot) so a following cmp can be annotated as a gate.
        if (rd >= 0) reg_clobber(rd);
    } else if (!strcmp(mn, "lsl") || !strcmp(mn, "lsr") || !strcmp(mn, "asr") ||
               !strcmp(mn, "and") || !strcmp(mn, "orr") || !strcmp(mn, "eor") ||
               !strcmp(mn, "mul") || !strcmp(mn, "bic") || !strcmp(mn, "mvn")) {
        if (rd >= 0) { reg_clobber(rd); loadsrc_clear(rd); }
    } else if (!strcmp(mn, "b") || !strcmp(mn, "bx") || !strcmp(mn, "pop")) {
        // Control-flow discontinuity (unconditional branch / indirect / pop): the
        // straight-line value tracking can't survive it — reset so we never annotate
        // a stale pointer past a merge point.
        reg_reset_all();
    } else if (!strcmp(mn, "bl") || !strcmp(mn, "blx")) {
        // Calls clobber r0..r3 per the ARM AAPCS. Conservative: clobber 0..3
        // AFTER the per-line annotation has run (so peephole still sees the
        // arg-set movs that preceded the bl).
        for (int i = 0; i <= 3; i++) reg_clobber(i);
    }
}

// Effective-address annotation: when a load/store dereferences a register whose value
// we track (from `ldr rX,=BASE` propagated through add/sub), resolve `[rX,#off]` /
// `[rX, rIdx]` to the concrete address and look it up in the symbol store. This is the
// "stop computing BASE+off by hand" win — turns `ldrb r0,[r4,#0x2E]` into
// `[0x13B556 = SELFTEST_STRUCT+0x2E]`, and `ldr r0,[r1, r0]` into `[0x13B54C + r0]`
// (a named table base even when the index is dynamic).
// Helper: format an address as "SYMBOL" / "SYMBOL+0xN" / "0xADDR" into a small buffer.
static const char *fmt_addr(uint32_t a, char *buf, size_t n) {
    const char *nm = sym_lookup(g_addrs, g_addrs_n, a);
    if (nm) { snprintf(buf, n, "%s", nm); return buf; }
    int ni = sym_nearest(g_addrs, g_addrs_n, a);
    if (ni >= 0 && (a - g_addrs[ni].key) < 0x400)
        snprintf(buf, n, "%s+0x%X", g_addrs[ni].name, a - g_addrs[ni].key);
    else
        snprintf(buf, n, "0x%06X", a);
    return buf;
}

// Read a big-endian value (1/2/4 bytes) from the best available source: the RAM
// snapshot (if --ram given — covers RAM globals + flash), else the flash image (flash
// region only). Returns 0 if unavailable.
static int mem_read(uint32_t addr, int size, uint32_t *out) {
    const uint8_t *src = NULL;
    uint32_t idx = 0;
    if (g_ram && (uint32_t)((addr & RAM_MASK) + size) <= g_ram_n) {
        src = g_ram; idx = addr & RAM_MASK;
    } else if (g_flash && addr >= BASE && (size_t)(addr - BASE) + size <= g_flash_n) {
        src = g_flash; idx = addr - BASE;
    } else {
        return 0;
    }
    uint32_t v = 0;
    for (int i = 0; i < size; i++) v = (v << 8) | src[idx + i];
    *out = v;
    return 1;
}
static int flash_word(uint32_t addr, uint32_t *out) { return mem_read(addr, 4, out); }

static void mem_annot(const char *line, char *out, size_t out_n) {
    out[0] = 0;
    // Parse mnemonic + destination register (to set load-source provenance).
    char mn[12] = {0};
    const char *t = strstr(line, "  ");
    while (t && t[2] == ' ') t++;
    if (!t) return;
    t += 2;
    while (*t == ' ') t++;
    int mi = 0;
    while (*t && isalpha((unsigned char)*t) && mi < 11) mn[mi++] = (char)tolower((unsigned char)*t++);
    while (*t == ' ') t++;
    int dreg = -1;
    if (*t == 'r') { dreg = (int)strtoul(t + 1, NULL, 10); if (dreg > 12) dreg = -1; }
    int is_load = !strcmp(mn, "ldr") || !strcmp(mn, "ldrb") || !strcmp(mn, "ldrh") ||
                  !strcmp(mn, "ldrsh") || !strcmp(mn, "ldrsb");
    int is_store = !strcmp(mn, "str") || !strcmp(mn, "strb") || !strcmp(mn, "strh");
    if (!is_load && !is_store) return;

    const char *lb = strstr(line, "[r");
    if (!lb) return;
    const char *p = lb + 2;
    if (!isdigit((unsigned char)*p)) return;
    int base = 0;
    while (isdigit((unsigned char)*p)) base = base * 10 + (*p++ - '0');
    if (base > 12 || !g_recent[base].has_imm) return;
    uint32_t bval = g_recent[base].imm;
    while (*p == ' ') p++;
    uint32_t eff = bval;
    int indexed = 0;
    char idx[8] = "";
    if (*p == ',') {
        p++;
        while (*p == ' ') p++;
        if (*p == '#') {
            eff = bval + (uint32_t)strtol(p + 1, NULL, 0);
        } else if (*p == 'r') {
            indexed = 1;
            int k = 0;
            while (*p && *p != ']' && *p != ',' && *p != ' ' && k < 7) idx[k++] = *p++;
            idx[k] = 0;
        } else {
            return;
        }
    } else if (*p != ']') {
        return;
    }
    if (eff < 0x10000) return;                  // skip small-constant false positives

    char ab[64];
    if (indexed) {
        // Indexed (table) access. Name the base, and — if it's a flash-resident pointer
        // table — peek the first entries and resolve them (jump/dispatch tables).
        int w = snprintf(out, out_n, "[%s + %s]", fmt_addr(eff, ab, sizeof ab), idx);
        uint32_t e0, e1, e2;
        // Peek the first table entries if they look like code/data pointers. Works for
        // flash-resident tables always, and RAM-resident ones with --ram.
        if (flash_word(eff, &e0) && e0 >= BASE && e0 < BASE + g_flash_n) {
            char b0[48], b1[48], b2[48];
            flash_word(eff + 4, &e1); flash_word(eff + 8, &e2);
            snprintf(out + w, out_n - w, "  table: %s, %s, %s, ...",
                     fmt_addr(e0, b0, sizeof b0),
                     (e1 >= BASE && e1 < BASE + g_flash_n) ? fmt_addr(e1, b1, sizeof b1) : "-",
                     (e2 >= BASE && e2 < BASE + g_flash_n) ? fmt_addr(e2, b2, sizeof b2) : "-");
        }
        return;
    }
    fmt_addr(eff, ab, sizeof ab);
    int has_sym = !(ab[0] == '0' && ab[1] == 'x');   // fmt_addr returns hex when unnamed
    // Live value from the RAM snapshot (--ram), sized by the access.
    int sz = (!strcmp(mn, "ldrb") || !strcmp(mn, "strb") || !strcmp(mn, "ldrsb")) ? 1
           : (!strcmp(mn, "ldrh") || !strcmp(mn, "strh") || !strcmp(mn, "ldrsh")) ? 2 : 4;
    char vbuf[24] = "";
    uint32_t val;
    if (g_ram && mem_read(eff, sz, &val))
        snprintf(vbuf, sizeof vbuf, " -> 0x%0*X", sz * 2, val);
    if (has_sym) snprintf(out, out_n, "[0x%06X = %s]%s", eff, ab, vbuf);
    else         snprintf(out, out_n, "[0x%06X]%s", eff, vbuf);
    // Record load-source so a following `cmp dreg,#K` can be flagged as a gate.
    if (is_load && dreg >= 0) loadsrc_set(dreg, eff);
}

// Indirect-branch + comparison-gate annotation (read-only; runs after mem_annot).
//   bx/blx rN  with a tracked rN  -> resolve the indirect target + symbol
//   cmp rN,#K  where rN was just loaded from a tracked addr -> "gate: [ADDR] == K"
static void flow_annot(const char *line, char *out, size_t out_n) {
    out[0] = 0;
    char mn[12] = {0};
    const char *t = strstr(line, "  ");
    while (t && t[2] == ' ') t++;
    if (!t) return;
    t += 2;
    while (*t == ' ') t++;
    int mi = 0;
    while (*t && isalpha((unsigned char)*t) && mi < 11) mn[mi++] = (char)tolower((unsigned char)*t++);
    while (*t == ' ') t++;
    int reg = -1;
    if (*t == 'r') { reg = (int)strtoul(t + 1, NULL, 10); if (reg > 12) reg = -1; }
    if (reg < 0) return;

    if ((!strcmp(mn, "bx") || !strcmp(mn, "blx")) && g_recent[reg].has_imm) {
        uint32_t tgt = g_recent[reg].imm & ~1u;        // drop Thumb bit
        char ab[64];
        snprintf(out, out_n, "-> %s", fmt_addr(tgt, ab, sizeof ab));
    } else if (!strcmp(mn, "cmp") && g_loadsrc[reg].valid) {
        while (*t && *t != ',') t++;
        while (*t == ',' || *t == ' ') t++;
        if (*t == '#') {
            uint32_t k = (uint32_t)strtoul(t + 1, NULL, 0);
            char ab[64];
            snprintf(out, out_n, "gate: [%s] == 0x%X", fmt_addr(g_loadsrc[reg].addr, ab, sizeof ab), k);
        }
    }
}

// PPM string annotation: `bl GET_STRING` with r0 tracked to a `04 hi lo` token pointer
// -> append the decoded English text (from a tools/symbols/ppm_strings.py sidecar).
static Sym *g_strs = NULL;
static int  g_strs_n = 0;
static uint32_t g_getstr_a = 0, g_wgetstr_a = 0;
static uint32_t addr_by_name(const char *nm) {
    for (int i = 0; i < g_addrs_n; i++)
        if (g_addrs[i].name && !strcmp(g_addrs[i].name, nm)) return g_addrs[i].key;
    return 0;
}
static void load_strings(const char *path) {
    FILE *f = fopen(path, "r");
    if (!f) return;
    int cap = 2048;
    g_strs = malloc((size_t)cap * sizeof(Sym));
    g_strs_n = 0;
    char line[256];
    while (fgets(line, sizeof line, f)) {
        char *tab = strchr(line, '\t');
        if (!tab) continue;
        *tab = 0;
        char *t = tab + 1;
        t[strcspn(t, "\r\n")] = 0;
        if (g_strs_n >= cap) { cap *= 2; g_strs = realloc(g_strs, (size_t)cap * sizeof(Sym)); }
        g_strs[g_strs_n].key = (uint32_t)strtoul(line, NULL, 10);
        g_strs[g_strs_n].name = strdup(t);
        g_strs_n++;
    }
    fclose(f);
    qsort(g_strs, (size_t)g_strs_n, sizeof *g_strs, sym_cmp);
    fprintf(stderr, "[disfw] strings: %s (%d)\n", path, g_strs_n);
}
static void str_annot(const char *line, char *out, size_t out_n) {
    out[0] = 0;
    if (!g_strs_n || (!g_getstr_a && !g_wgetstr_a)) return;
    const char *p = strstr(line, " bl 0x");
    if (!p) return;
    uint32_t tgt = (uint32_t)strtoul(p + 4, NULL, 16);
    if (tgt != g_getstr_a && tgt != g_wgetstr_a) return;
    if (!g_recent[0].has_imm) return;
    uint32_t tok = g_recent[0].imm, b0, b1, b2;
    if (!mem_read(tok, 1, &b0) || b0 != 0x04) return;        // token is `04 hi lo`
    if (!mem_read(tok + 1, 1, &b1) || !mem_read(tok + 2, 1, &b2)) return;
    const char *s = sym_lookup(g_strs, g_strs_n, (b1 << 8) | b2);
    if (s) snprintf(out, out_n, "str=\"%s\"", s);
}

// Parse a load/store line's memory operand. Returns 1 and fills the fields if the line
// is `ldr*/str* rD, [rBase {, #off | , rIdx}]`. (Shared by --struct xref.)
static int parse_mem(const char *line, int *base, long *off, int *indexed,
                     int *is_load, int *size) {
    char mn[12] = {0};
    const char *t = strstr(line, "  ");
    while (t && t[2] == ' ') t++;
    if (!t) return 0;
    t += 2;
    while (*t == ' ') t++;
    int mi = 0;
    while (*t && isalpha((unsigned char)*t) && mi < 11) mn[mi++] = (char)tolower((unsigned char)*t++);
    int ld = !strcmp(mn, "ldr") || !strcmp(mn, "ldrb") || !strcmp(mn, "ldrh") ||
             !strcmp(mn, "ldrsh") || !strcmp(mn, "ldrsb");
    int st = !strcmp(mn, "str") || !strcmp(mn, "strb") || !strcmp(mn, "strh");
    if (!ld && !st) return 0;
    *is_load = ld;
    *size = (!strcmp(mn, "ldrb") || !strcmp(mn, "strb") || !strcmp(mn, "ldrsb")) ? 1
          : (!strcmp(mn, "ldrh") || !strcmp(mn, "strh") || !strcmp(mn, "ldrsh")) ? 2 : 4;
    const char *lb = strstr(line, "[r");
    if (!lb) return 0;
    const char *p = lb + 2;
    if (!isdigit((unsigned char)*p)) return 0;
    int b = 0;
    while (isdigit((unsigned char)*p)) b = b * 10 + (*p++ - '0');
    if (b > 12) return 0;
    *base = b; *off = 0; *indexed = 0;
    while (*p == ' ') p++;
    if (*p == ',') {
        p++;
        while (*p == ' ') p++;
        if (*p == '#') *off = strtol(p + 1, NULL, 0);
        else if (*p == 'r') *indexed = 1;
        else return 0;
    } else if (*p != ']') {
        return 0;
    }
    return 1;
}

// --struct 0xBASE: sweep the whole image with the value-tracker and report every
// setter (store) and reader (load) of the struct's fields, grouped by offset. The
// payoff of the tracker — auto-produces the field map (which I built by hand for
// 0x13B528: writers at +0/+2/+4/+10/+12/+28, the +0 reader gate). With --ram each
// field's live value is shown.
typedef struct { int off; uint32_t pc; uint8_t wr, size, indexed; } StructAcc;
static int sa_cmp(const void *A, const void *B) {
    const StructAcc *a = A, *b = B;
    if (a->off != b->off) return a->off - b->off;
    return (a->pc > b->pc) - (a->pc < b->pc);
}
static void struct_xref(DCT3Core *core, uint32_t base, uint32_t window) {
    static StructAcc acc[16384];
    int n = 0;
    reg_reset_all();
    char buf[256], line[320];
    uint32_t a = BASE;
    uint32_t end = BASE + (uint32_t)g_flash_n;
    while (a + 2 <= end && n < (int)(sizeof acc / sizeof acc[0])) {
        uint32_t o = a - BASE;
        uint16_t op = (uint16_t)((g_flash[o] << 8) | g_flash[o + 1]);
        struct ARMInstructionInfo info;
        int bytes = 2;
        ARMDecodeThumb(op, &info);
        if ((op & 0xF800) == 0xF000 && o + 4 <= g_flash_n) {
            uint16_t op2 = (uint16_t)((g_flash[o + 2] << 8) | g_flash[o + 3]);
            struct ARMInstructionInfo info2, comb;
            ARMDecodeThumb(op2, &info2);
            if (ARMDecodeThumbCombine(&info, &info2, &comb)) {
                ARMDisassemble(&comb, &core->cpu, NULL, a + 4, buf, sizeof buf);
                snprintf(line, sizeof line, "%08X: %04X %04X  %s", a, op, op2, buf);
                bytes = 4;
            } else {
                ARMDisassemble(&info, &core->cpu, NULL, a + 4, buf, sizeof buf);
                snprintf(line, sizeof line, "%08X: %04X       %s", a, op, buf);
            }
        } else {
            ARMDisassemble(&info, &core->cpu, NULL, a + 4, buf, sizeof buf);
            snprintf(line, sizeof line, "%08X: %04X       %s", a, op, buf);
        }
        int b, indexed, is_load, size;
        long off;
        if (parse_mem(line, &b, &off, &indexed, &is_load, &size) && g_recent[b].has_imm) {
            uint32_t eff = g_recent[b].imm + (indexed ? 0 : (uint32_t)off);
            if (eff >= base && eff < base + window) {
                acc[n].off = indexed ? -1 : (int)(eff - base);
                acc[n].pc = a; acc[n].wr = (uint8_t)!is_load;
                acc[n].size = (uint8_t)size; acc[n].indexed = (uint8_t)indexed;
                n++;
            }
        }
        update_peephole(line, a);
        a += (uint32_t)bytes;
    }
    qsort(acc, (size_t)n, sizeof acc[0], sa_cmp);
    const char *bn = sym_lookup(g_addrs, g_addrs_n, base);
    char bb[64];
    printf("; struct @ 0x%06X%s%s  window 0x%X  — %d access sites%s\n",
           base, bn ? " = " : "", bn ? bn : "", window, n,
           g_ram ? "  (live values from --ram)" : "");
    int i = 0;
    while (i < n) {
        int off = acc[i].off, j = i, size = acc[i].size;
        char wpc[220] = "", rpc[220] = "";
        int nw = 0, nr = 0;
        while (j < n && acc[j].off == off) {
            char *dst = acc[j].wr ? wpc : rpc;
            int *cnt = acc[j].wr ? &nw : &nr;
            if (*cnt < 6) {
                size_t l = strlen(dst);
                snprintf(dst + l, sizeof wpc - l, "%s0x%06X", l ? ", " : "", acc[j].pc);
            }
            (*cnt)++;
            j++;
        }
        char val[24] = "";
        uint32_t v;
        if (off >= 0 && g_ram && mem_read(base + (uint32_t)off, size, &v))
            snprintf(val, sizeof val, "  [=0x%0*X]", size * 2, v);
        char label[16];
        if (off < 0) snprintf(label, sizeof label, "[idx]");
        else         snprintf(label, sizeof label, "+0x%02X", off);
        const char *szn = size == 1 ? "byte" : size == 2 ? "half" : "word";
        printf("  %-6s %-4s%s  W:%-3d%s%s   R:%-3d%s%s\n",
               label, szn, val,
               nw, nw ? " " : "", wpc,
               nr, nr ? " " : "", rpc);
        i = j;
    }
    fmt_addr(base, bb, sizeof bb);   // (silence unused if no sym)
    (void)bb;
}

// Look at the current line — if it's a `bl 0x<target>` and the target is one
// of the known send helpers, annotate r0/r1 immediates via peephole. Returns
// extra text to append (caller concatenates with the addr-annotation).
static void peephole_annot(const char *line, char *out, size_t out_n) {
    out[0] = 0;
    // Find bl + addr
    const char *p = strstr(line, " bl 0x");
    if (!p) p = strstr(line, " blx 0x");
    if (!p) p = strstr(line, " b 0x");           // unconditional branch can also send via tail-call
    if (!p) return;
    while (*p && *p != '0') p++;
    if (!*p) return;
    uint32_t target = (uint32_t)strtoul(p, NULL, 16);
    HookKind k = classify_target(target);
    if (k == HOOK_NONE) return;
    int written = 0;
    switch (k) {
        case HOOK_TASK_SEND:
        case HOOK_TASK_SEND_IRQ: {
            const char *msg_name = NULL;
            if (g_recent[1].has_imm) msg_name = sym_lookup(g_msgs, g_msgs_n, g_recent[1].imm);
            if (g_recent[0].has_imm) {
                int n = snprintf(out + written, out_n - written,
                                 "%stask=%u", written ? ", " : "", g_recent[0].imm);
                if (n > 0) written += n;
            }
            if (g_recent[1].has_imm) {
                int n = snprintf(out + written, out_n - written,
                                 "%smsg=0x%X%s%s", written ? " " : "",
                                 g_recent[1].imm,
                                 msg_name ? "=" : "", msg_name ? msg_name : "");
                if (n > 0) written += n;
            }
            break;
        }
        case HOOK_REBOOT_FN:
        case HOOK_REASON_SETTER: {
            if (g_recent[0].has_imm) {
                const char *reason_name = sym_lookup(g_rsns, g_rsns_n, g_recent[0].imm);
                int n = snprintf(out + written, out_n - written,
                                 "reason=0x%02X%s%s", g_recent[0].imm,
                                 reason_name ? "=" : "",
                                 reason_name ? reason_name : "");
                if (n > 0) written += n;
            }
            break;
        }
        case HOOK_ASSERT_LOG: {
            if (g_recent[0].has_imm) {
                const char *m = sym_lookup(g_msgs, g_msgs_n, g_recent[0].imm);
                int n = snprintf(out + written, out_n - written,
                                 "code=0x%04X%s%s", g_recent[0].imm,
                                 m ? "=" : "", m ? m : "");
                if (n > 0) written += n;
            }
            if (g_recent[1].has_imm) {
                int n = snprintf(out + written, out_n - written,
                                 "%sdata=0x%X", written ? " " : "", g_recent[1].imm);
                if (n > 0) written += n;
            }
            break;
        }
        default: break;
    }
}

// ---------- main ----------

static const char *auto_locate_sidecar(uint32_t fw_id) {
    // Glob `tools/symbols/*.symbols.txt` and match by `# fw-id: <id>` header, so every
    // model's store auto-registers (no hardcoded list — a new bring-up's sidecar is
    // picked up the moment gen_symbols_txt.py writes it). Returns a static buf; NULL if
    // none. SYMDIR overrides the directory.
    static char found[1024];
    char target[16];
    snprintf(target, sizeof target, "%08x", fw_id);
    const char *dir = getenv("SYMDIR");
    if (!dir || !*dir) dir = "tools/symbols";
    DIR *d = opendir(dir);
    if (!d) return NULL;
    struct dirent *de;
    while ((de = readdir(d))) {
        size_t n = strlen(de->d_name);
        if (n < 12 || strcmp(de->d_name + n - 12, ".symbols.txt") != 0) continue;
        char path[1024];
        snprintf(path, sizeof path, "%s/%s", dir, de->d_name);
        FILE *f = fopen(path, "r");
        if (!f) continue;
        char line[256];
        while (fgets(line, sizeof line, f)) {
            if (strstr(line, "# fw-id:") && strstr(line, target)) {
                fclose(f);
                closedir(d);
                snprintf(found, sizeof found, "%s", path);
                return found;
            }
            if (line[0] != '#' && line[0] != '\n' && line[0] != '[') break;  // past header
        }
        fclose(f);
    }
    closedir(d);
    return NULL;
}

int main(int argc, char **argv) {
    const char *flash_path = NULL;
    const char *addr_str = NULL;
    const char *count_str = NULL;
    int thumb = 1;
    const char *symbols_path = NULL;
    const char *ram_path = NULL;
    const char *strings_path = NULL;
    const char *struct_str = NULL;
    uint32_t struct_window = 0x80;
    int annotate = 1;

    for (int i = 1; i < argc; i++) {
        if (!strcmp(argv[i], "--symbols") && i + 1 < argc) symbols_path = argv[++i];
        else if (!strcmp(argv[i], "--ram") && i + 1 < argc) ram_path = argv[++i];
        else if (!strcmp(argv[i], "--strings") && i + 1 < argc) strings_path = argv[++i];
        else if (!strcmp(argv[i], "--struct") && i + 1 < argc) struct_str = argv[++i];
        else if (!strcmp(argv[i], "--structsize") && i + 1 < argc) struct_window = (uint32_t)strtoul(argv[++i], NULL, 0);
        else if (!strcmp(argv[i], "--no-annot"))           annotate = 0;
        else if (!strcmp(argv[i], "arm"))                  thumb = 0;
        else if (!flash_path)                              flash_path = argv[i];
        else if (!addr_str)                                addr_str = argv[i];
        else if (!count_str)                               count_str = argv[i];
    }
    if (!flash_path || (!addr_str && !struct_str)) {
        fprintf(stderr,
                "usage: %s <flash.fls> <addr> [count] [arm] [--symbols PATH] [--ram DUMP] [--no-annot]\n"
                "       %s <flash.fls> --struct 0xBASE [--structsize N] [--ram DUMP]\n",
                argv[0], argv[0]);
        return 1;
    }

    FILE *f = fopen(flash_path, "rb");
    if (!f) { perror("open"); return 1; }
    fseek(f, 0, SEEK_END);
    long n = ftell(f);
    fseek(f, 0, SEEK_SET);
    uint8_t *d = malloc((size_t)n);
    if (fread(d, 1, (size_t)n, f) != (size_t)n) return 1;
    fclose(f);
    g_flash = d; g_flash_n = (size_t)n;

    if (ram_path) {
        FILE *rf = fopen(ram_path, "rb");
        if (!rf) { perror("open --ram"); return 1; }
        fseek(rf, 0, SEEK_END);
        long rn = ftell(rf);
        fseek(rf, 0, SEEK_SET);
        uint8_t *rd = malloc((size_t)rn);
        if (!rd || fread(rd, 1, (size_t)rn, rf) != (size_t)rn) return 1;
        fclose(rf);
        g_ram = rd; g_ram_n = (size_t)rn;
        fprintf(stderr, "[disfw] RAM snapshot: %s (%ld bytes) — values/tables resolve live\n",
                ram_path, rn);
    }

    uint32_t fw_id = fw_build_id(d, (size_t)n);
    uint32_t addr = addr_str ? (uint32_t)strtoul(addr_str, NULL, 0) : 0;
    int count = count_str ? atoi(count_str) : 32;

    if (annotate) {
        if (!symbols_path) symbols_path = auto_locate_sidecar(fw_id);
        if (symbols_path && load_symbols(symbols_path)) {
            fprintf(stderr, "[disfw] symbols: %s  (%d addrs, %d msgs, %d reasons)\n",
                    symbols_path, g_addrs_n, g_msgs_n, g_rsns_n);
            // Also auto-load a sibling scratchpad if present — session RE log.
            // Same .txt format as the [addresses] section of symbols.txt (the
            // [addresses] section header is missing, but load_symbols accepts
            // bare `<hex> <NAME>` lines after a `[addresses]` marker; we keep
            // scratch.txt prefixed with that header — see tools/symbols/scratch.py).
            char scratch[1024];
            const char *dot = strstr(symbols_path, ".symbols.txt");
            if (dot) {
                size_t base_len = (size_t)(dot - symbols_path);
                snprintf(scratch, sizeof scratch, "%.*s.scratch.txt",
                         (int)base_len, symbols_path);
                int before_addrs = g_addrs_n, before_msgs = g_msgs_n, before_rsns = g_rsns_n;
                if (load_symbols(scratch)) {
                    int added = (g_addrs_n - before_addrs) + (g_msgs_n - before_msgs)
                              + (g_rsns_n - before_rsns);
                    if (added > 0) {
                        fprintf(stderr, "[disfw] scratchpad: %s  (+%d entries)\n",
                                scratch, added);
                        // load_symbols qsorts post-insert, so the addr table
                        // is re-sorted with scratch entries — binary search
                        // still finds them.
                    }
                }
            }
        } else if (annotate) {
            fprintf(stderr, "[disfw] no symbols sidecar for fw-id %08x — running un-annotated\n", fw_id);
        }
    }

    DCT3Core *core = dct3_core_create();
    dct3_write_bytes(core, BASE, d, (size_t)n);
    reg_reset_all();

    // --struct 0xBASE: whole-image field setter/reader xref, then exit.
    if (struct_str) {
        uint32_t sbase = (uint32_t)strtoul(struct_str, NULL, 0);
        struct_xref(core, sbase, struct_window ? struct_window : 0x80);
        dct3_core_destroy(core);
        free(d);
        if (g_ram) free((void *)g_ram);
        return 0;
    }

    // Build the BL-caller + table-entry reverse map (once). Annotation-only;
    // also useful even if symbols missed, but we only run when annotation is on.
    if (annotate) {
        xref_scan(d, (size_t)n);
        fprintf(stderr, "[disfw] xref: %d refs scanned\n", g_xref_n);
    }
    if (strings_path) {
        load_strings(strings_path);
        g_getstr_a  = addr_by_name("GET_STRING");
        g_wgetstr_a = addr_by_name("W_GET_STRING");
        if (!g_getstr_a) g_getstr_a = addr_by_name("PPM_STRING_LOOKUP");
    }

    char buf[256];
    char line[320];
    char annot[256];
    char peep[128];
    uint32_t a = addr;
    for (int i = 0; i < count; ++i) {
        uint32_t o = a - BASE;
        struct ARMInstructionInfo info;
        int line_bytes = 4;     // bytes consumed by this instruction
        if (thumb) {
            uint16_t op = (uint16_t)((d[o] << 8) | d[o + 1]);
            ARMDecodeThumb(op, &info);
            if ((op & 0xF800) == 0xF000) {
                struct ARMInstructionInfo info2, combined;
                uint16_t op2 = (uint16_t)((d[o + 2] << 8) | d[o + 3]);
                ARMDecodeThumb(op2, &info2);
                if (ARMDecodeThumbCombine(&info, &info2, &combined)) {
                    ARMDisassemble(&combined, &core->cpu, NULL, a + 4, buf, sizeof buf);
                    snprintf(line, sizeof line, "%08X: %04X %04X  %s", a, op, op2, buf);
                    line_bytes = 4;
                } else {
                    ARMDisassemble(&info, &core->cpu, NULL, a + 4, buf, sizeof buf);
                    snprintf(line, sizeof line, "%08X: %04X       %s", a, op, buf);
                    line_bytes = 2;
                }
            } else {
                ARMDisassemble(&info, &core->cpu, NULL, a + 4, buf, sizeof buf);
                snprintf(line, sizeof line, "%08X: %04X       %s", a, op, buf);
                line_bytes = 2;
            }
        } else {
            uint32_t op = ((uint32_t)d[o] << 24) | (d[o + 1] << 16) | (d[o + 2] << 8) | d[o + 3];
            ARMDecodeARM(op, &info);
            ARMDisassemble(&info, &core->cpu, NULL, a + 8, buf, sizeof buf);
            snprintf(line, sizeof line, "%08X: %08X  %s", a, op, buf);
            line_bytes = 4;
        }

        if (annotate) {
            // Prologue banner: if this address is a known symbol AND the bytes
            // look like a Thumb push prologue (0xB5xx / 0xB4xx) OR it's the
            // first insn we're emitting, print a banner line above with the
            // function name + caller/table summary.
            const char *fn_name = sym_lookup(g_addrs, g_addrs_n, a);
            uint8_t b0 = d[a - BASE];
            int is_prologue_byte = (b0 == 0xB5 || b0 == 0xB4);
            if (fn_name && (is_prologue_byte || i == 0)) {
                int n_bl = 0, n_arm_bl = 0, n_tab = 0;
                uint32_t bls[4], arm_bls[4], tabs[4];
                int n_bls = 0, n_arm_bls = 0, n_tabs = 0;
                xref_summary(a, &n_bl, &n_arm_bl, &n_tab,
                             bls,    &n_bls,    4,
                             arm_bls,&n_arm_bls,4,
                             tabs,   &n_tabs,   4);
                printf("\n; ==== %s @ 0x%08X  (%d bl + %d arm-bl callers, %d table refs) ====\n",
                       fn_name, a, n_bl, n_arm_bl, n_tab);
                if (n_bls > 0) {
                    printf(";   bl from: ");
                    for (int k = 0; k < n_bls; k++) {
                        uint32_t lr = bls[k];
                        const char *near = NULL;
                        int idx = sym_nearest(g_addrs, g_addrs_n, lr);
                        if (idx >= 0 && (lr - g_addrs[idx].key) < 0x1000)
                            near = g_addrs[idx].name;
                        printf("0x%06X%s%s%s ", lr,
                               near ? " (" : "", near ? near : "", near ? ")" : "");
                    }
                    if (n_bl > n_bls) printf("...+%d more", n_bl - n_bls);
                    printf("\n");
                }
                if (n_arm_bls > 0) {
                    printf(";   ARM bl from: ");
                    for (int k = 0; k < n_arm_bls; k++) {
                        uint32_t lr = arm_bls[k];
                        const char *near = NULL;
                        int idx = sym_nearest(g_addrs, g_addrs_n, lr);
                        if (idx >= 0 && (lr - g_addrs[idx].key) < 0x1000)
                            near = g_addrs[idx].name;
                        printf("0x%06X%s%s%s ", lr,
                               near ? " (" : "", near ? near : "", near ? ")" : "");
                    }
                    if (n_arm_bl > n_arm_bls) printf("...+%d more", n_arm_bl - n_arm_bls);
                    printf("\n");
                }
                if (n_tabs > 0) {
                    printf(";   table at: ");
                    for (int k = 0; k < n_tabs; k++) printf("0x%06X ", tabs[k]);
                    if (n_tab > n_tabs) printf("...+%d more", n_tab - n_tabs);
                    printf("\n");
                }
            }

            annot_for_line(line, annot, sizeof annot, a, !thumb);
            peephole_annot(line, peep, sizeof peep);
            if (peep[0]) {
                size_t alen = strlen(annot);
                if (alen) snprintf(annot + alen, sizeof annot - alen, "  -- %s", peep);
                else      snprintf(annot, sizeof annot, "%s", peep);
            }
            // Effective-address (tracked-pointer) annotation — must run BEFORE
            // update_peephole consumes this line, so it sees the register state as of
            // the access.
            char mem[160];
            mem_annot(line, mem, sizeof mem);
            if (mem[0]) {
                size_t alen = strlen(annot);
                snprintf(annot + alen, sizeof annot - alen, "%s%s",
                         alen ? "  " : "", mem);
            }
            char flow[96];
            flow_annot(line, flow, sizeof flow);
            if (flow[0]) {
                size_t alen = strlen(annot);
                snprintf(annot + alen, sizeof annot - alen, "%s%s",
                         alen ? "  " : "", flow);
            }
            char strn[128];
            str_annot(line, strn, sizeof strn);
            if (strn[0]) {
                size_t alen = strlen(annot);
                snprintf(annot + alen, sizeof annot - alen, "%s%s",
                         alen ? "  " : "", strn);
            }
            emit(line, annot);
            update_peephole(line, a);
        } else {
            printf("%s\n", line);
        }
        a += (uint32_t)line_bytes;
    }

    free(d);
    return 0;
}
